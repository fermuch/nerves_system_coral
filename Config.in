## Config.in
```kconfig
menu "Custom packages"
	source "$NERVES_DEFCONFIG_DIR/package/Config.in"
endmenu
```

## nerves_defconfig
```kconfig
BR2_CCACHE=y
BR2_CCACHE_DIR=$HOME/.buildroot-ccache
BR2_CCACHE_INITIAL_SETUP="--max-size=12G"
BR2_JLEVEL=0
BR2_PER_PACKAGE_DIRECTORIES=n
BR2_BACKUP_SITE="http://dl.nerves-project.org"
BR2_DL_DIR=$HOME/.nerves/dl


# BR2_aarch64=y
# BR2_ARM_FPU_VFPV3=y
# BR2_TOOLCHAIN_BUILDROOT_GLIBC=y
# BR2_TOOLCHAIN_BUILDROOT_CXX=y
# BR2_ENABLE_DEBUG=y
# BR2_GLOBAL_PATCH_DIR="${BR2_EXTERNAL_NERVES_PATH}/patches ${NERVES_DEFCONFIG_DIR}/patches"
# BR2_REPRODUCIBLE=y
# BR2_ROOTFS_SKELETON_CUSTOM=y
# BR2_ROOTFS_SKELETON_CUSTOM_PATH="${BR2_EXTERNAL_NERVES_PATH}/board/nerves-common/skeleton"
# BR2_INIT_NONE=y
# BR2_ROOTFS_DEVICE_TABLE="${BR2_EXTERNAL_NERVES_PATH}/board/nerves-common/device_table.txt"
# BR2_ENABLE_LOCALE_WHITELIST="locale-archive"
# BR2_GENERATE_LOCALE="en_US.UTF-8"
# BR2_ROOTFS_OVERLAY="${BR2_EXTERNAL_NERVES_PATH}/board/nerves-common/rootfs_overlay ${NERVES_DEFCONFIG_DIR}/rootfs_overlay"
# # BR2_ROOTFS_POST_BUILD_SCRIPT="${NERVES_DEFCONFIG_DIR}/post-build.sh ${BR2_EXTERNAL_NERVES_PATH}/board/nerves-common/post-build.sh"
# BR2_ROOTFS_POST_BUILD_SCRIPT="${BR2_EXTERNAL_NERVES_PATH}/board/nerves-common/post-build.sh"
# # BR2_ROOTFS_POST_IMAGE_SCRIPT="${NERVES_DEFCONFIG_DIR}/post-createfs.sh board/freescale/common/imx/imx8-bootloader-prepare.sh board/freescale/common/imx/post-image.sh"
# BR2_ROOTFS_POST_IMAGE_SCRIPT="board/freescale/common/imx/imx8-bootloader-prepare.sh board/freescale/common/imx/post-image.sh"
# BR2_ROOTFS_POST_SCRIPT_ARGS="${UBOOT_DIR}/arch/arm/dts/imx8mq-phanbell.dtb"
# BR2_LINUX_KERNEL=y
# BR2_LINUX_KERNEL_LATEST_VERSION=y
# BR2_LINUX_KERNEL_USE_ARCH_DEFAULT_CONFIG=y
# BR2_LINUX_KERNEL_DTS_SUPPORT=y
# BR2_LINUX_KERNEL_INTREE_DTS_NAME="freescale/imx8mq-phanbell"
# BR2_LINUX_KERNEL_INSTALL_TARGET=y
# BR2_LINUX_KERNEL_NEEDS_HOST_OPENSSL=y
# BR2_PACKAGE_BUSYBOX_CONFIG="${BR2_EXTERNAL_NERVES_PATH}/board/nerves-common/busybox.config"
# BR2_PACKAGE_F2FS_TOOLS=y
# BR2_PACKAGE_LINUX_FIRMWARE=y
# BR2_PACKAGE_LINUX_FIRMWARE_IBT=y
# BR2_PACKAGE_FREESCALE_IMX=y
# BR2_PACKAGE_FREESCALE_IMX_PLATFORM_IMX8M=y
# BR2_PACKAGE_FIRMWARE_IMX=y
# BR2_PACKAGE_CA_CERTIFICATES=y
# BR2_PACKAGE_LIBP11=y
# BR2_PACKAGE_UNIXODBC=y
# BR2_PACKAGE_DTC=y
# BR2_PACKAGE_LIBMNL=y
# BR2_PACKAGE_WIRELESS_REGDB=y
# BR2_PACKAGE_WPA_SUPPLICANT=y
# BR2_PACKAGE_WPA_SUPPLICANT_WIRED=y
# BR2_PACKAGE_WPA_SUPPLICANT_AP_SUPPORT=y
# BR2_PACKAGE_WPA_SUPPLICANT_MESH_NETWORKING=y
# BR2_PACKAGE_WPA_SUPPLICANT_AUTOSCAN=y
# BR2_PACKAGE_WPA_SUPPLICANT_HOTSPOT=y
# BR2_PACKAGE_WPA_SUPPLICANT_DEBUG_SYSLOG=y
# BR2_PACKAGE_WPA_SUPPLICANT_WPS=y
# BR2_PACKAGE_WPA_SUPPLICANT_WPA3=y
# BR2_PACKAGE_WPA_SUPPLICANT_CTRL_IFACE=y
# BR2_TARGET_ROOTFS_EXT2=y
# BR2_TARGET_ROOTFS_EXT2_4=y
# BR2_TARGET_ROOTFS_EXT2_SIZE="200M"
# # BR2_TARGET_ROOTFS_TAR is not set
# BR2_TARGET_ARM_TRUSTED_FIRMWARE=y
# BR2_TARGET_ARM_TRUSTED_FIRMWARE_CUSTOM_TARBALL=y
# BR2_TARGET_ARM_TRUSTED_FIRMWARE_CUSTOM_TARBALL_LOCATION="$(call github,nxp-imx,imx-atf,lf-6.1.36-2.1.0)/imx-atf-lf-6.1.36-2.1.0.tar.gz"
# BR2_TARGET_ARM_TRUSTED_FIRMWARE_PLATFORM="imx8mq"
# BR2_TARGET_UBOOT=y
# BR2_TARGET_UBOOT_BUILD_SYSTEM_KCONFIG=y
# BR2_TARGET_UBOOT_LATEST_VERSION=y
# BR2_TARGET_UBOOT_BOARD_DEFCONFIG="imx8mq_phanbell"
# BR2_TARGET_UBOOT_CONFIG_FRAGMENT_FILES="${NERVES_DEFCONFIG_DIR}/uboot.config"
# # BR2_TARGET_UBOOT_PATCH="${NERVES_DEFCONFIG_DIR}/uboot"
# # BR2_TARGET_UBOOT_CONFIG_FRAGMENT_FILES="${NERVES_DEFCONFIG_DIR}/uboot/nerves.config"
# BR2_TARGET_UBOOT_NEEDS_DTC=y
# BR2_TARGET_UBOOT_NEEDS_ATF_BL31=y
# BR2_TARGET_UBOOT_NEEDS_IMX_FIRMWARE=y
# BR2_TARGET_UBOOT_USE_BINMAN=y
# BR2_TARGET_UBOOT_FORMAT_CUSTOM=y
# BR2_TARGET_UBOOT_FORMAT_CUSTOM_NAME="u-boot-nodtb.bin"
# BR2_TARGET_UBOOT_SPL=y
# BR2_PACKAGE_HOST_DOSFSTOOLS=y
# BR2_PACKAGE_HOST_GENIMAGE=y
# BR2_PACKAGE_HOST_LIBP11=y
# BR2_PACKAGE_HOST_MTOOLS=y
# BR2_PACKAGE_HOST_UBOOT_TOOLS_FIT_SUPPORT=y
# BR2_PACKAGE_HOST_UBOOT_TOOLS_ENVIMAGE=y
# BR2_PACKAGE_HOST_UBOOT_TOOLS_ENVIMAGE_SOURCE="${NERVES_DEFCONFIG_DIR}/uboot/uboot.env"
# BR2_PACKAGE_HOST_UBOOT_TOOLS_ENVIMAGE_SIZE="131072"
# BR2_PACKAGE_UBOOT_TOOLS_MKIMAGE=y
# BR2_PACKAGE_HOST_IMX_MKIMAGE=y
# BR2_PACKAGE_HOST_UBOOT_TOOLS=y
# BR2_NERVES_SYSTEM_NAME="nerves_system_coral"
# BR2_NERVES_ADDITIONAL_IMAGE_FILES="${NERVES_DEFCONFIG_DIR}/fwup.conf"
# BR2_PACKAGE_NBTTY=y
# BR2_PACKAGE_NERVES_CONFIG=y
# BR2_PACKAGE_COMPULAB=y
# BR2_PACKAGE_SHARUTILS=y

# https://github.com/buildroot/buildroot/blob/2025.05/configs/freescale_imx8mqevk_defconfig
BR2_aarch64=y
BR2_ARM_FPU_VFPV3=y
BR2_PACKAGE_HOST_LINUX_HEADERS_CUSTOM_6_12=y
# these patches come from (buildroot) board/freescale/imx8mqevk/patches
BR2_GLOBAL_PATCH_DIR="${BR2_EXTERNAL_NERVES_PATH}/patches ${NERVES_DEFCONFIG_DIR}/patches"
BR2_DOWNLOAD_FORCE_CHECK_HASHES=y
BR2_TARGET_GENERIC_GETTY_PORT="ttymxc0"
BR2_ROOTFS_POST_IMAGE_SCRIPT="${NERVES_DEFCONFIG_DIR}/post-createfs.sh board/freescale/common/imx/imx8-bootloader-prepare.sh ${NERVES_DEFCONFIG_DIR}/post-image.sh"
BR2_ROOTFS_POST_SCRIPT_ARGS="${UBOOT_DIR}/arch/arm/dts/imx8mq-evk.dtb"
BR2_LINUX_KERNEL=y
BR2_LINUX_KERNEL_CUSTOM_TARBALL=y
BR2_LINUX_KERNEL_CUSTOM_TARBALL_LOCATION="$(call github,nxp-imx,linux-imx,lf-6.12.3-1.0.0)/linux-imx-lf-6.12.3-1.0.0.tar.gz"
BR2_LINUX_KERNEL_DEFCONFIG="imx_v8"
BR2_LINUX_KERNEL_DTS_SUPPORT=y
BR2_LINUX_KERNEL_INTREE_DTS_NAME="freescale/imx8mq-evk"
BR2_LINUX_KERNEL_NEEDS_HOST_OPENSSL=y
BR2_PACKAGE_FREESCALE_IMX=y
BR2_PACKAGE_FREESCALE_IMX_PLATFORM_IMX8M=y
BR2_PACKAGE_FIRMWARE_IMX=y
BR2_TARGET_ROOTFS_EXT2=y
BR2_TARGET_ROOTFS_EXT2_4=y
BR2_TARGET_ROOTFS_EXT2_SIZE="120M"
BR2_TARGET_ARM_TRUSTED_FIRMWARE=y
BR2_TARGET_ARM_TRUSTED_FIRMWARE_CUSTOM_TARBALL=y
BR2_TARGET_ARM_TRUSTED_FIRMWARE_CUSTOM_TARBALL_LOCATION="$(call github,nxp-imx,imx-atf,lf-6.12.3-1.0.0)/imx-atf-lf-6.12.3-1.0.0.tar.gz"
BR2_TARGET_ARM_TRUSTED_FIRMWARE_PLATFORM="imx8mq"
BR2_TARGET_ARM_TRUSTED_FIRMWARE_BL31=y
BR2_TARGET_UBOOT=y
BR2_TARGET_UBOOT_BUILD_SYSTEM_KCONFIG=y
BR2_TARGET_UBOOT_CUSTOM_TARBALL=y
BR2_TARGET_UBOOT_CUSTOM_TARBALL_LOCATION="$(call github,nxp-imx,uboot-imx,lf-6.12.3-1.0.0)/uboot-imx-lf-6.12.3-1.0.0.tar.gz"
BR2_TARGET_UBOOT_BOARD_DEFCONFIG="imx8mq_evk"
BR2_TARGET_UBOOT_NEEDS_DTC=y
BR2_TARGET_UBOOT_NEEDS_OPENSSL=y
BR2_TARGET_UBOOT_NEEDS_GNUTLS=y
BR2_TARGET_UBOOT_FORMAT_CUSTOM=y
BR2_TARGET_UBOOT_FORMAT_CUSTOM_NAME="u-boot-nodtb.bin"
BR2_TARGET_UBOOT_SPL=y
BR2_PACKAGE_HOST_DOSFSTOOLS=y
BR2_PACKAGE_HOST_GENIMAGE=y
BR2_PACKAGE_HOST_IMX_MKIMAGE=y
BR2_PACKAGE_HOST_MTOOLS=y
BR2_PACKAGE_HOST_UBOOT_TOOLS=y
BR2_PACKAGE_HOST_UBOOT_TOOLS_FIT_SUPPORT=y
BR2_NERVES_SYSTEM_NAME="nerves_system_coral"
BR2_PACKAGE_NBTTY=y
BR2_PACKAGE_NERVES_CONFIG=y
# Nerves requirement: Rootfs must be read-only
BR2_TARGET_GENERIC_REMOUNT_ROOTFS_RW=n
# Needed for env file
BR2_TARGET_UBOOT_CONFIG_FRAGMENT_FILES="${NERVES_DEFCONFIG_DIR}/uboot.config"
# Env image
BR2_PACKAGE_HOST_UBOOT_TOOLS_ENVIMAGE=y
BR2_PACKAGE_HOST_UBOOT_TOOLS_ENVIMAGE_SOURCE="${NERVES_DEFCONFIG_DIR}/uboot/uboot.env"
BR2_PACKAGE_HOST_UBOOT_TOOLS_ENVIMAGE_SIZE="0x20000"
```

## package/Config.in
```kconfig
# Custom packages for Nerves System Coral

menu "WiFi and Networking"
	source "$NERVES_DEFCONFIG_DIR/package/imx-board-wlan/Config.in"
endmenu
```

## package/imx-board-wlan/Config.in
```kconfig
config BR2_PACKAGE_IMX_BOARD_WLAN
	bool "imx-board-wlan"
	depends on BR2_LINUX_KERNEL
	help
	  WiFi driver for Google Coral Dev Board (i.MX8MQ).
	  
	  This package provides the Qualcomm CLD WiFi driver
	  specifically adapted for the i.MX8MQ platform used
	  in the Google Coral Dev Board.
	  
	  The driver is built as an out-of-tree kernel module
	  and will be automatically loaded at boot.
	  
	  https://coral.googlesource.com/imx-board-wlan-src
```
